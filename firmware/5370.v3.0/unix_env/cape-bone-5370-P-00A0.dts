/*
 * PRU for hp 5370 processor board v3
 *
 * Can't use the BBB-supplied PRU .dts because the pinmux requirements conflict with our 5370 cape .dts
 *
 * This program is free software; you can redistribute it and/or modify
 * it under the terms of the GNU General Public License version 2 as
 * published by the Free Software Foundation.
 */
/dts-v1/;
/plugin/;

/ {
	compatible = "ti,beaglebone", "ti,beaglebone-black";

	/* identification */
	part-number = "cape-bone-5370-P";
	version = "00A0";

	/* state the resources this cape uses */
	exclusive-use =
		/* the hardware IP uses */
		"pru0";

	fragment@2 {
		target = <&pruss>;
		__overlay__ {
			status = "okay";
		};
	};
};
